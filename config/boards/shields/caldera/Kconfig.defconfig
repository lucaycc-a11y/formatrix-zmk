## config/boards/shields/caldera/Kconfig.defconfig
```kconfig
# ForMatrix (Caldera) Default Kconfig

if SHIELD_CALDERA_LEFT

config ZMK_KEYBOARD_NAME
    default "ForMatrix L"

config ZMK_BLE_PASSKEY_ENTRY
    default y

endif

if SHIELD_CALDERA_RIGHT

config ZMK_KEYBOARD_NAME
    default "ForMatrix R"

config ZMK_BLE_PASSKEY_ENTRY
    default y

endif
```

## config/boards/shields/formatrix/Kconfig.defconfig
```kconfig
# ForMatrix Default Kconfig

if SHIELD_FORMATRIX_LEFT

config ZMK_KEYBOARD_NAME
    default "ForMatrix"

endif

if SHIELD_FORMATRIX_RIGHT

config ZMK_KEYBOARD_NAME
    default "ForMatrix"

endif
```

## config/boards/shields/formatrix/Kconfig.shield
```kconfig
# ForMatrix Shield Kconfig

config SHIELD_FORMATRIX_LEFT
    def_bool $(shields_list_contains,formatrix_left)

config SHIELD_FORMATRIX_RIGHT
    def_bool $(shields_list_contains,formatrix_right)
```
